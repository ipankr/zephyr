## CMakeLists.txt
```
#
# Copyright (c) 2026 CrossControl AB
#
# SPDX-License-Identifier: Apache-2.0
#

cmake_minimum_required(VERSION 3.20.0)
find_package(Zephyr REQUIRED HINTS $ENV{ZEPHYR_BASE})
project(transport_i2c)

FILE(GLOB app_sources
  src/*.c
)

target_sources(app PRIVATE ${app_sources})
```

## prj.conf
```kconfig
#
# Copyright (c) 2026 CrossControl AB
#
# SPDX-License-Identifier: Apache-2.0
#

CONFIG_ZTEST=y
CONFIG_NET_BUF=y
CONFIG_ZCBOR=y
CONFIG_MCUMGR=y
CONFIG_I2C=y
CONFIG_I2C_TARGET=y
CONFIG_MCUMGR_TRANSPORT_I2C=y
```

## boards/native_sim.conf
```kconfig
#
# Copyright (c) 2026 CrossControl AB
#
# SPDX-License-Identifier: Apache-2.0
#

CONFIG_I2C_EMUL=y
CONFIG_I2C_TARGET=y
```

## boards/frdm_mcxa266.overlay
```dts
/*
 * Copyright (c) 2026 CrossControl AB
 * SPDX-License-Identifier: Apache-2.0
 */

/ {
	aliases {
		smp-i2c = &lpi2c1;
	};
};
```

## boards/native_sim.overlay
```dts
/*
 * Copyright (c) 2026 CrossControl AB
 * SPDX-License-Identifier: Apache-2.0
 */

/ {
	aliases {
		smp-i2c = &i2c0;
	};
};
```

## src/main.c
```c
/*
 * Copyright (c) 2026 CrossControl AB
 *
 * SPDX-License-Identifier: Apache-2.0
 */

#if !defined(CONFIG_MCUMGR_TRANSPORT_I2C)
#error "Expected Kconfig option CONFIG_MCUMGR_TRANSPORT_I2C not enabled"
#endif
```
